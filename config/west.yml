## config/west.yml
```yaml
manifest:
  remotes:
    # zmk official
    - name: zmkfirmware
      url-base: https://github.com/zmkfirmware
    - name: proprietarypenguin 
      url-base: https://github.com/proprietarypenguin
  projects:
    - name: zmk
      remote: zmkfirmware
      revision: main
      # remote: kuolemax
      # revision: encoder-fix
      import: app/west.yml
  self:
    path: config
```
